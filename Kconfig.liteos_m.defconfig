## Kconfig.liteos_m.soc
```kconfig
config SOC_COMPANY_ASRMICRO
    bool

if SOC_COMPANY_ASRMICRO
config SOC_COMPANY
    default "asrmicro"

rsource "*/Kconfig.liteos_m.soc"
endif # SOC_COMPANY_ASRMICRO
```

## asr582x/Kconfig.liteos_m.defconfig.series
```kconfig
if SOC_SERIES_ASR582X

rsource "Kconfig.liteos_m.defconfig.asr5822s"

config SOC_SERIES
    string
    default "asr582x"

endif
```

## asr582x/Kconfig.liteos_m.series
```kconfig
config SOC_SERIES_ASR582X
    bool "ASR582X Series"
    select ARM
    select SOC_COMPANY_ASRMICRO
    select CPU_CORTEX_M4
    help
        Enable support for ASR582X series
```

## asr582x/Kconfig.liteos_m.soc
```kconfig
choice
    prompt "ASR582X series SoC"
    depends on SOC_SERIES_ASR582X

config SOC_ASR5822S
    bool "SoC ASR5822S"

endchoice
```
